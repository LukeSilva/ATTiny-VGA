charactermap:
; character a
.byte 0x70,0x07
.byte 0x07,0x70
.byte 0x77,0x77
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.byte 0x00,0x00
;character b
.byte 0x77,0x07
.byte 0x07,0x70
.byte 0x77,0x07
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.byte 0x00,0x00
;character c
.byte 0x70,0x77
.byte 0x07,0x00
.byte 0x07,0x00
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.byte 0x00,0x00
;character d
.byte 0x77,0x07
.byte 0x07,0x70
.byte 0x07,0x70
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.byte 0x00,0x00
;character e
.byte 0x77,0x77
.byte 0x07,0x00
.byte 0x77,0x07
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.byte 0x00,0x00
;character f
.byte 0x77,0x77
.byte 0x07,0x00
.byte 0x77,0x07
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.byte 0x00,0x00
;character g
.byte 0x70,0x77
.byte 0x07,0x00
.byte 0x07,0x00
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.byte 0x00,0x00
;character h
.byte 0x07,0x70
.byte 0x07,0x70
.byte 0x07,0x70
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.byte 0x00,0x00
;character i
.byte 0x77,0x07
.byte 0x70,0x00
.byte 0x70,0x00
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.byte 0x00,0x00
;character j
.byte 0x77,0x77
.byte 0x00,0x07
.byte 0x00,0x07
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.byte 0x00,0x00
;character k
.byte 0x07,0x07
.byte 0x07,0x07
.byte 0x77,0x00
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.byte 0x00,0x00
;character l
.byte 0x07,0x00
.byte 0x07,0x00
.byte 0x07,0x00
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.byte 0x00,0x00
;character m
.byte 0x07,0x70
.byte 0x77,0x77
.byte 0x07,0x70
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.byte 0x00,0x00
;character n
.byte 0x07,0x70
.byte 0x77,0x70
.byte 0x07,0x77
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.byte 0x00,0x00
;character o
.byte 0x70,0x07
.byte 0x07,0x70
.byte 0x07,0x70
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.byte 0x00,0x00
;character p
.byte 0x77,0x07
.byte 0x07,0x70
.byte 0x07,0x70
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.byte 0x00,0x00
.balign 2 
